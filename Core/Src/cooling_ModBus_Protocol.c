/**
 ******************************************************************************
 * @file    : cooling_ModBus_Protocol.c
 * @brief   : TMS 液冷协议应用程序
 * @version : 1.0.1
 ******************************************************************************
 * @attention
 * 
 * 
 ******************************************************************************
 */
#include "cooling_ModBus_Protocol.h"


#define USART_REC_LEN 200 
#define RXBUFFERSIZE 1   




uint8_t CoolingRecvBuf[50] = {0};    //接收BUF
uint8_t CoolingSendBuf[50] = {0};    //发送BUF
uint8_t CoolingDataBuf[50] = {0};    //水冷数据BUF

uint8_t CoolingWorkStatus = 0;       //工作状态
uint8_t CoolingCount = 0;            //计数器
uint8_t CoolingRecvCount = 0;        //接收计数器
uint8_t CoolingSendCount = 0;        //发送计数器
uint8_t CoolingRecvNum = 0;          //接收个数
uint8_t CoolingSendNum = 0;          //发送个数
uint8_t CoolingTimeOutFlag = 0;      //超时使能
uint32_t CoolingTimeOutCount = 0;    //超时计数器

uint8_t Rx_dat = 0;

uint32_t modbus_time;
uint8_t USART_RX_BUF[USART_REC_LEN]; 
uint16_t USART_RX_STA;
uint8_t aRxBuffer[RXBUFFERSIZE];

Modbus_Report_Pack_TypeDef Modbus_Report_Pack = {0};  //水冷实时数据
Cooling_HandleTypeDef* Cooling_Handle;


uint8_t aucCoolingCHECKALLCmd[8]	=  {0xAA, 0x03, 0x00, 0x00, 0x00, 0x12, 0xDC, 0x1C};//查询12个寄存器指令
uint8_t aucCoolingOFFCmd[8]		=  {0xAA, 0x06, 0x00, 0x00, 0x00, 0x00, 0x90, 0x11};//关机指令
uint8_t aucCoolingONCmd[27]		=  {0xAA, 0x10, 0x00, 0x00, 0x00, 0x09, 0x12, 0x00, 0x01, 
											0x00, 0x64, 0x00, 0x01, 0x00, 0x05, 0x00, 0x00, 0x02, 
                                			0x58, 0x03, 0x20, 0x03, 0x20, 0x01, 0xF4, 0x21, 0x6A}; //开机指令，目标温度10度
uint8_t aucCoolingTargTempCmd[8]		=	{0xAA, 0x06, 0x00, 0x05, 0x00, 0x00, 0x00, 0x00};//设置指令
uint8_t aucCooling06Cmd[8]				=	{0xAA, 0x06, 0x00, 0x00, 0x00, 0x00, 0x00, 0x00};//设置指令
uint8_t aucCooling10Cmd[27]				=	{0xAA, 0x10, 0x00, 0x00, 0x00, 0x09, 0x12, 0x00, 0x01, 	\
											0x00, 0x64, 0x00, 0x01, 0x00, 0x05, 0x00, 0x00, 0x02, 	\
                							0x58, 0x03, 0x20, 0x03, 0x20, 0x01, 0xF4, 0x00, 0x00}; //开机指令，目标温度10度
											// 校验结果是6A21 

uint8_t modbus_slave_addr = 0xAA; // 从机地址
uint8_t modbus_Tx_buff[100];	  // 发送缓冲区

void copyArray(int source[], int target[], int length) {
    memcpy(target, source, length * sizeof(int));
}

void aucCooling(){
    Cooling_Handle->modbus_count++;
}

uint8_t auchCRCHi[] = {
0x00, 0xC1, 0x81, 0x40, 0x01, 0xC0, 0x80, 0x41, 0x01, 0xC0,
0x80, 0x41, 0x00, 0xC1, 0x81, 0x40, 0x01, 0xC0, 0x80, 0x41,
0x00, 0xC1, 0x81, 0x40, 0x00, 0xC1, 0x81, 0x40, 0x01, 0xC0,
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0x80, 0x41, 0x00, 0xC1, 0x81, 0x40};

char auchCRCLo[] = {
0x00, 0xC0, 0xC1, 0x01, 0xC3, 0x03, 0x02, 0xC2, 0xC6, 0x06,
0x07, 0xC7, 0x05, 0xC5, 0xC4, 0x04, 0xCC, 0x0C, 0x0D, 0xCD,
0x0F, 0xCF, 0xCE, 0x0E, 0x0A, 0xCA, 0xCB, 0x0B, 0xC9, 0x09,
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0x43, 0x83, 0x41, 0x81, 0x80, 0x40};

static uint16_t CRC16(uint8_t *puchMsg, uint16_t usDataLen)
{
	uint8_t uchCRCHi = 0xFF;
	uint8_t uchCRCLo = 0xFF;
	unsigned uIndex = 0;
	while (usDataLen--)
	{
		uIndex = uchCRCHi ^ *puchMsg++;
		uchCRCHi = uchCRCLo ^ auchCRCHi[uIndex];
		uchCRCLo = auchCRCLo[uIndex];
	}
	return (uchCRCHi<<8 | uchCRCLo);
}

static void send_data(uint8_t *buff, uint8_t len)
{
	HAL_UART_Transmit_IT(Cooling_Handle->huart, (uint8_t *)buff, len); // 发送数据   把buff
														 // while (__HAL_UART_GET_FLAG(&huart2, UART_FLAG_TC) != SET); // 等待发送结束
}

static void CoolingOperateSystemON(){
	send_data(aucCoolingONCmd, 27);
}

static void CoolingOperateSystemOFF(){
	send_data(aucCoolingOFFCmd, 8);

}

static void CoolingOperateGetData(){
	send_data(aucCoolingCHECKALLCmd, 8);

}

static void CoolingOperateSetTemp(uint8_t value){
	uint16_t crcCheck = 0;
	aucCoolingTargTempCmd[4] = ((value + 50) * 10) / 256;
	aucCoolingTargTempCmd[5] = ((value + 50) * 10) % 256;
	
	crcCheck = CRC16(aucCoolingTargTempCmd, 6);
	aucCoolingTargTempCmd[6] = crcCheck / 256;
	aucCoolingTargTempCmd[7] = crcCheck % 256;

	send_data(aucCoolingTargTempCmd, 8);

}



static void CoolingOperate(Cooling_OperateTypeDef operateCMD, uint8_t value){

	switch(operateCMD)
	{
        
		case SYSTEM_ON:
            CoolingOperateSystemON();

			break;

		case SYSTEM_OFF:
            CoolingOperateSystemOFF();
			
            break;

		case SYSTEM_GET_DATA:
            CoolingOperateGetData();

            break;

		case SYSTEM_SET_TEMP_DATA:
            CoolingOperateSetTemp(value);

            break;

		default:
			return;
			
	}
}


/**
 * @brief 串口收发函数，需要在串口中断中配置对本函数的调用
 * 
 */
static void RxCplt(void)
{
	if ((USART_RX_STA & 0x8000) == 0) 
	{
		modbus_time = 0;
		USART_RX_BUF[USART_RX_STA & 0X3FFF] = aRxBuffer[0];
		USART_RX_STA++;
		if (USART_RX_STA > (USART_REC_LEN - 1))
			USART_RX_STA = 0; 
	}
	HAL_UART_Receive_IT(Cooling_Handle->huart, (uint8_t *)aRxBuffer, 1);
	
}


static void CoolingWorkCMD(){
	CoolingCount++;
	if(CoolingCount == 1) //	更新频率为20hz时，每0.5秒触发一次
	{
		CoolingOperate(SYSTEM_GET_DATA,NULL);
		
		if(Modbus_Report_Pack.CoolingRunState == 1)
		{
			CoolingWorkStatus = Cooling_CMD;
		}
		else
		{
			CoolingWorkStatus = Cooling_STOP;
		}
	}
	else if(CoolingCount == 2) //更新频率为20hz时，每1秒触发一次
	{
		if(BAT_DATA_Pack.BAT_Temperature > 25){
			CoolingOperate(SYSTEM_SET_TEMP_DATA,5);
		}
		else if(BAT_DATA_Pack.BAT_Temperature > 20 && BAT_DATA_Pack.BAT_Temperature <= 25)
		{
			CoolingOperate(SYSTEM_SET_TEMP_DATA,7);
		}
		else if(BAT_DATA_Pack.BAT_Temperature > 18 && BAT_DATA_Pack.BAT_Temperature <= 20)
		{
			CoolingOperate(SYSTEM_SET_TEMP_DATA,9);
		}
		else if(BAT_DATA_Pack.BAT_Temperature > 16 && BAT_DATA_Pack.BAT_Temperature <= 18)
		{
			//盲区
		}
		else if(BAT_DATA_Pack.BAT_Temperature > 5 && BAT_DATA_Pack.BAT_Temperature <= 16)
		{
			CoolingOperate(SYSTEM_SET_TEMP_DATA,17);
		}
		else if(BAT_DATA_Pack.BAT_Temperature < 5)
		{
			CoolingOperate(SYSTEM_SET_TEMP_DATA,17);
		}
	}
	else if(CoolingCount >= 3) //更新频率为20hz时，每1.5秒触发一次
	{
		CoolingCount = 0; 
	}
}


/**
 * @brief 液冷控制器启动函数，液冷状态机
 *        需要将此函数放入主函数体循环中
 *        或创建轮询任务
 * @todo  需完成数据更新、断帧判定、目标温度计算、报警处理
 *        1. 获取液冷模组数据状态
 *        2. 判断开机调节，查询是否开机
 *        3. 检查开机是否完成，
 *        4. 
 * @param hcooling 
 */
static Cooling_StatusTypeDef Run(){
    static Cooling_StateTypeDef CoolingWorkStatus = Cooling_STOP ;
    if(BAT_DATA_Pack.BatID  > 0){
        switch(CoolingWorkStatus){
			case Cooling_STOP:
			{//关机状态下发送开机指令
				CoolingWorkStatus = Cooling_GET_STATE;
				CoolingOperate(SYSTEM_ON,NULL);
				break;
			}
			case Cooling_GET_STATE:
			{//读取液冷所有寄存器数值
				CoolingWorkStatus = Cooling_CHECK;
				CoolingOperate(SYSTEM_GET_DATA,NULL);
				break;
			}
			case Cooling_CHECK:
			{//判定水冷工作状态，正常开机继续执行，异常开机返回0步骤
				if(Modbus_Report_Pack.CoolingRunState == 1)
				{
					CoolingWorkStatus = Cooling_CMD;
				}
				else
				{
					CoolingWorkStatus = Cooling_STOP;
				}
				break;
			}
			case Cooling_CMD:
			{//水冷控制
				CoolingWorkCMD();
				break;
			}
			default:
				break;
		}
	}
	else
	{
		CoolingWorkStatus = Cooling_STOP;
		CoolingOperate(SYSTEM_OFF,NULL);
	
    }
	return Cooling_OK;
}

/**
 * @brief 液冷控制器停止函数
 *        
 * @todo  暂时无用
 * @param hcooling 
 */
static Cooling_StatusTypeDef Stop(){

	return Cooling_OK;
}

/**
 * @brief 液冷控制器初始化函数
 *        
 * @todo  初始化所需数据,读取版本号
 *  
 */
static Cooling_StatusTypeDef Init(){
	USART_RX_STA = 0; // 准备接收
    

	return Cooling_OK;
}

static Cooling_StatusTypeDef UpdataPack(){

	return Cooling_OK;
}


/**
 * @brief 液冷控制器注册函数
 *        绑定所需结构函数
 * @todo  串口绑定方式待定
 * @param huartcooling:绑定收发数据接口
 */
Cooling_StatusTypeDef CoolingCreate( UART_HandleTypeDef *huartcooling)
{

	Cooling_Handle->Run          = Run;
	Cooling_Handle->Stop         = Stop;
	Cooling_Handle->Init         = Init;
	Cooling_Handle->UpdataPack   = UpdataPack;
	Cooling_Handle->RxCplt   	= RxCplt;
	
	Cooling_Handle->huart = huartcooling;
	
	return Cooling_OK;
}

